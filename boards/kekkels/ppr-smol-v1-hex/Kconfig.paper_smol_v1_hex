## boards/kekkels/ppr-smol-v1-hex/Kconfig.paper_smol_v1_hex
```kconfig
# Copyright (c) 2024 Nordic Semiconductor ASA
# SPDX-License-Identifier: Apache-2.0

config BOARD_PAPER_SMOL_V1_HEX
	select SOC_NRF52833_QDAA
```

## boards/kekkels/ppr-smol-v1-hex/board.yml
```yaml
# Copyright (c) 2024 Nordic Semiconductor ASA
# SPDX-License-Identifier: Apache-2.0

board:
  name: paper_smol_v1_hex
  full_name: "Paper Smol Version 1" 
  vendor: kekkels
  socs:
    - name: nrf52833
```

## boards/kekkels/ppr-smol-v1/board.yml
```yaml
# Copyright (c) 2024 Nordic Semiconductor ASA
# SPDX-License-Identifier: Apache-2.0

board:
  name: ppr_smol_v1
  full_name: "Paper Smol Version 1" 
  vendor: kekkels
  socs:
    - name: nrf52833
```
